## Documentation/devicetree/bindings/bluetooth/bluetooth_power.txt
```
* Bluetooth Controller
Bluetooth controller communicates with the Bluetooth Host using HCI Transport layer.
HCI Transport layer can be based on UART or USB serial communication protocol.

Required properties:
  - compatible: Should be "brcm,bcm4356-bt"
  - brcm,bt-reset-gpio: GPIO pin to bring BT Controller out of reset

Optional properties:
  None

Example:

bt-bcm4356 {
	compatible = "brcm,bcm4356-bt";
	brcm,bt-reset-gpio = <&gpio2 4 0>;
};
```

## Documentation/devicetree/bindings/mmc/hi3798cv200-dw-mshc.txt
```
* Hisilicon specific extensions to the Synopsys Designware Mobile
  Storage Host Controller

Read synopsys-dw-mshc.txt for more details

The Synopsys designware mobile storage host controller is used to interface
a SoC with storage medium such as eMMC or SD/MMC cards. This file documents
differences between the core Synopsys dw mshc controller properties described
by synopsys-dw-mshc.txt and the properties used by the Hisilicon specific
extensions to the Synopsys Designware Mobile Storage Host Controller.

Required Properties:

* compatible: should be one of the following.
  - "hisilicon,hi3798cv200-dw-mshc": for controllers with hi3798cv200 specific extensions.

Optional Properties:
* clocks: from common clock binding: if ciu-drive and ciu-sample are
  specified in clock-names, should contain handles to these clocks.

* clock-names:Apart from the clock-names described in synopsys-dw-mshc.txt
  two more clocks "ciu-drive" and "ciu-sample" are supported. They are used
  to control the clock phases, "ciu-sample" is required for tuning high-speed modes.

Example:

	/* for Hi3798cv200 */

	/* SoC portion */
	emmc: mmc@9830000 {
		compatible = "hisilicon,hi3798cv200-dw-mshc";
		reg = <0x9830000 0x10000>;
		interrupts = <GIC_SPI 35 IRQ_TYPE_LEVEL_HIGH>;
		clocks = <&crg HISTB_MMC_CIU_CLK>,
			 <&crg HISTB_MMC_BIU_CLK>,
			 <&crg HISTB_MMC_SAMPLE_CLK>;
		clock-names = "ciu", "biu", "ciu-sample";
	};

	/* Board portion */
	&emmc {
		status = "okay";
		num-slots = <1>;
		fifo-depth = <256>;
		clock-frequency = <200000000>;
		cap-mmc-highspeed;
		mmc-ddr-1_8v;
		mmc-hs200-1_8v;
		non-removable;
		bus-width = <8>;
	};
```

## Documentation/devicetree/bindings/pci/hisilicon-histb-pcie.txt
```
HiSilicon STB PCIe host bridge DT description

HiSilicon PCIe host controller is based on Designware PCI core.
It shares common functions with PCIe Designware core driver and inherits
common properties defined in
Documentation/devicetree/bindings/pci/designware-pci.txt.

Additional properties are described here:

Required properties
- compatible: Should be one of the following strings
		 "hisilicon,histb-pcie",
		 "hisilicon,hi3798cv200-pcie"
- reg: Should contain sysctl, rc_dbi, config registers location and length.
- reg-names: Must include the following entries:
  "sysctrl": system control registers of PCIe controller;
  "rc_dbi": configuration space of PCIe controller;
  "config": configuration transaction space of PCIe controller.
- interrupts: MSI interrupt.
- interrupt-names: Must include "msi" entries.
- clocks: List of phandle and clock specifier pairs as listed
		in clock-names property.
- clock-name: Must include the following entries:
  "aux_clk": auxiliary gate clock;
  "pipe_clk": pipe gate clock;
  "sys_clk": sys gate clock;
  "bus_clk": bus gate clock.
- resets: List of phandle and reset specifier pairs as listed
			in reset-names property
- reset-names: Must include the following entries:
  "soft_reset": soft reset;
  "sys_reset": sys reset;
  "bus_rest": bus reset.

Optional properties:
- power-gpios: pcie device power control gpio if needed;
- power-gpios-active-high: must include this propty
		if active level is high.
- status: Either "ok" or "disabled".

Example:
	pcie@f9860000 {
		compatible = "hisilicon,histb-pcie", "snps,dw-pcie";
		reg = <0xf9860000 0x1000>,
			<0xf0000000 0x2000>,
			<0xf2000000 0x01000000>;
		reg-names = "sysctrl", "rc_dbi", "config";
		#address-cells = <3>;
		#size-cells = <2>;
		device_type = "pci";
		num-lanes = <1>;
		ranges=<0x81000000 0 0 0xf4000000 0 0x00010000
			0x82000000 0 0xf3000000 0xf3000000 0 0x01000000>;
		interrupts = <GIC_SPI 128 IRQ_TYPE_LEVEL_HIGH>;
		interrupt-names = "msi";
		#interrupt-cells = <1>;
		interrupt-map-mask = <0 0 0 7>;
		interrupt-map = <0x0 0 0 1 &gic 0 131 4>;
		clocks = <&crg PCIE_AUX_CLK>,
			 <&crg PCIE_PIPE_CLK>,
			 <&crg PCIE_SYS_CLK>,
			 <&crg PCIE_BUS_CLK>;
		clock-names = "aux_clk", "pipe_clk", "sys_clk", "bus_clk";
		resets = <&crg 0x18c 6>, <&crg 0x18c 5>, <&crg 0x18c 4>;
		reset-names = "soft_reset", "sys_reset", "bus_reset";
	};
```

## Documentation/devicetree/bindings/phy/phy-hi3798cv200-combphy.txt
```
HiSilicon STB PCIE/SATA/USB3 PHY

Required properties:
- compatible: Should be "hisilicon,hi3798cv200-combphy"
- reg: Should be the address space for COMBPHY configuration and state
  registers in peripheral controller, e.g. PERI_COMBPHY0_CFG and
  PERI_COMBPHY0_STATE for COMBPHY0 Hi3798cv200 SoC.
- #phy-cells: Should be 1.  The cell number is used to select the phy mode
  as defined in <dt-bindings/phy/phy.h>.
- clocks: The phandle to clock provider and clock specifier pair.
- resets: The phandle to reset controller and reset specifier pair.

Refer to phy/phy-bindings.txt for the generic PHY binding properties

Note:
- The device node should be a child of peripheral controller that contains
  COMBPHY configuration/state and PERI_CTRL register used to select PHY mode.
- The combphy devices should have aliases defined.

Example:

aliases {
	combphy0 = &combphy0;
	combphy1 = &combphy1;
};

peri_ctrl: peri_ctrl@8a20000 {
	compatible = "hisilicon,hi3798cv200-perictrl", "syscon",
		     "simple-mfd";
	reg = <0x8a20000 0x1000>;
	#address-cells = <1>;
	#size-cells = <1>;
	ranges = <0x0 0x8a20000 0x1000>;

	combphy0: phy@850 {
		compatible = "hisilicon,hi3798cv200-combphy";
		reg = <0x850 0x8>;
		#phy-cells = <1>;
		clocks = <&crg HISTB_COMBPHY0_CLK>;
		resets = <&crg 0x188 4>;
	};

	combphy1: phy@858 {
		compatible = "hisilicon,hi3798cv200-combphy";
		reg = <0x858 0x8>;
		#phy-cells = <1>;
		clocks = <&crg HISTB_COMBPHY1_CLK>;
		resets = <&crg 0x188 12>;
	};
};
```

## Documentation/devicetree/bindings/phy/phy-hisi-inno-usb2.txt
```
HiSilicon INNO USB2 PHY

Required properties:
- compatible: Should be one of the following strings:
	"hisilicon,inno-usb2-phy",
	"hisilicon,hi3798cv200-usb2-phy".
- reg: Should be the address space for INNO USB 2.0 PHY configuration register
  in peripheral controller, e.g. PERI_USB0 on Hi3798CV200 SoC.
- #phy-cells: Should be 1. The specifier is the index of the PHY port to
  reference.
- clocks: The phandle and clock specifier pair for reference clock utmi_refclk.
- resets: The list of phandle and reset specifier pairs for each reset signal
  in reset-names.
- reset-names: Should contain "power_on", "utmi0" and "utmi1". The "utmi1"
  should exist only if the device has two PHY port.

Refer to phy/phy-bindings.txt for the generic PHY binding properties

Notes:
- The device node should be a child of peripheral controller that contains
  INNO USB 2.0 PHY configuration register used to set up PHY.

Example:

perictrl: peripheral-controller@8a20000 {
	compatible = "hisilicon,hi3798cv200-perictrl", "syscon",
		     "simple-mfd";
	reg = <0x8a20000 0x1000>;
	#address-cells = <1>;
	#size-cells = <1>;
	ranges = <0x0 0x8a20000 0x1000>;

	usb2_phy1: phy@120 {
		compatible = "hisilicon,hi3798cv200-usb2-phy";
		reg = <0x120 0x4>;
		#phy-cells = <1>;
		clocks = <&crg HISTB_USB2_PHY1_REF_CLK>;
		resets = <&crg 0xbc 4>,
			 <&crg 0xbc 8>,
			 <&crg 0xbc 9>;
		reset-names = "power_on", "utmi0", "utmi1";
	};

	usb2_phy2: phy@124 {
		compatible = "hisilicon,hi3798cv200-usb2-phy";
		reg = <0x124 0x4>;
		#phy-cells = <1>;
		clocks = <&crg HISTB_USB2_PHY2_REF_CLK>;
		resets = <&crg 0xbc 6>,
			 <&crg 0xbc 10>;
		reset-names = "power_on", "utmi0";
	};
};
```

## arch/arm/configs/hi3716cv200_defconfig
```kconfig
CONFIG_ARCH_HISI=y
CONFIG_ARCH_HIX5HD2=y
CONFIG_SERIAL_AMBA_PL011=y
CONFIG_SERIAL_AMBA_PL011_CONSOLE=y
CONFIG_SMP=y

CONFIG_AEABI=y
CONFIG_VFP=y
CONFIG_VFPv3=y

CONFIG_TMPFS=y 
CONFIG_DEVTMPFS=y
CONFIG_DEVTMPFS_MOUNT=y 

CONFIG_HISI_IOMMU=y

##CONFIG_BLK_DEV_RAM=y
##CONFIG_BLK_DEV_RAM_COUNT=16
##CONFIG_BLK_DEV_RAM_SIZE=4096 

##CONFIG_USB=y
##CONFIG_USB_EHCI_HCD=y
##CONFIG_USB_EHCI_HCD_PLATFORM=y

CONFIG_MMC=y
CONFIG_MMC_BLOCK_MINORS=32
CONFIG_MMC_ARMMMCI=y
CONFIG_MMC_DW=y
CONFIG_MMC_DW_K3=y
CONFIG_MMC_DW_HI3798CV200=y 

CONFIG_BLK_CMDLINE_PARSER=y
CONFIG_PARTITION_ADVANCED=y
CONFIG_CMDLINE_PARTITION=y

#CONFIG_PRINTK_TIME=y
#CONFIG_DEBUG_INFO=y
#CONFIG_DEBUG_FS=y
#CONFIG_MAGIC_SYSRQ=y
#CONFIG_DEBUG_KERNEL=y
#CONFIG_LOCKUP_DETECTOR=y 

#CONFIG_PREEMPT=y

CONFIG_HIGHMEM=y

#CONFIG_HAVE_CC_STACKPROTECTOR=y
#CONFIG_CC_STACKPROTECTOR=y
# CONFIG_CC_STACKPROTECTOR_NONE is not set
#CONFIG_CC_STACKPROTECTOR_REGULAR=y
# CONFIG_CC_STACKPROTECTOR_STRONG is not set 

CONFIG_EXT4_FS=y
#CONFIG_TMPFS=y 

CONFIG_NET=y
CONFIG_UNIX=y
```

## arch/arm/configs/hi3798cv100_defconfig
```kconfig
CONFIG_ARCH_HISI=y
CONFIG_ARCH_HIX5HD2=y
CONFIG_SERIAL_AMBA_PL011=y
CONFIG_SERIAL_AMBA_PL011_CONSOLE=y

CONFIG_SMP=y
CONFIG_HIGHMEM=y

CONFIG_AEABI=y
CONFIG_VFP=y
CONFIG_VFPv3=y

####CONFIG_BLK_DEV_INITRD=y
####CONFIG_BLK_DEV_RAM=y
####CONFIG_BLK_DEV_RAM_COUNT=16
####CONFIG_BLK_DEV_RAM_SIZE=4096 

CONFIG_TMPFS=y 
CONFIG_DEVTMPFS=y
CONFIG_DEVTMPFS_MOUNT=y 

CONFIG_HISI_IOMMU=y

CONFIG_CGROUPS=y
CONFIG_BLK_CGROUP=y
CONFIG_CGROUP_PIDS=y
CONFIG_CGROUP_DEVICE=y
CONFIG_CGROUP_CPUACCT=y
CONFIG_CGROUP_PERF=y

CONFIG_MMC=y
CONFIG_MMC_BLOCK_MINORS=32
CONFIG_MMC_ARMMMCI=y
CONFIG_MMC_DW=y
CONFIG_MMC_DW_K3=y
CONFIG_MMC_DW_HI3798CV200=y 

CONFIG_BLK_CMDLINE_PARSER=y
CONFIG_PARTITION_ADVANCED=y
CONFIG_CMDLINE_PARTITION=y

CONFIG_USB=y
CONFIG_USB_XHCI_HCD=y
CONFIG_USB_XHCI_PLATFORM=y
CONFIG_USB_EHCI_HCD=y
CONFIG_USB_EHCI_HCD_PLATFORM=y
CONFIG_USB_OHCI_HCD=y
CONFIG_USB_OHCI_HCD_PLATFORM=y
CONFIG_USB_STORAGE=y
CONFIG_ATA=y
CONFIG_BLK_DEV_SD=y

CONFIG_EXT4_FS=y
CONFIG_VFAT_FS=y

CONFIG_NLS_ISO8859_1=y
CONFIG_NLS_CODEPAGE_437=y

CONFIG_NET=y
CONFIG_UNIX=y
CONFIG_INET=y
CONFIG_NETDEVICES=y
CONFIG_HIX5HD2_GMAC=y

CONFIG_DEBUG_KERNEL=y
CONFIG_DEBUG_INITCALL=y
```

## arch/arm/configs/hi3798cv200_defconfig
```kconfig
CONFIG_USE_OF=y
CONFIG_ATAGS=y
CONFIG_ARM_APPENDED_DTB=y
CONFIG_ARM_ATAG_DTB_COMPAT=y
CONFIG_ARM_ATAG_DTB_COMPAT_CMDLINE_EXTEND=y
CONFIG_CMDLINE_FROM_BOOTLOADER=y 

CONFIG_SMP=y
CONFIG_ARCH_HISI=y
######CONFIG_ARCH_HIX5HD2=y
CONFIG_SERIAL_AMBA_PL011=y
CONFIG_SERIAL_AMBA_PL011_CONSOLE=y

CONFIG_HIGHMEM=y

CONFIG_AEABI=y
CONFIG_VFP=y
CONFIG_VFPv3=y

CONFIG_STAGING=y
CONFIG_ANDROID=y
CONFIG_ION=y
CONFIG_ION_HISI=y
CONFIG_HI3798CV200_ION=y
CONFIG_ION_UNMAPPED_HEAP=y
CONFIG_ION_HISI_UNMAPPED_HEAP=y
CONFIG_ION_HISI_UNMAPPED_BASE=0x02800000
CONFIG_ION_HISI_UNMAPPED_SIZE=0x00400000
CONFIG_MAILBOX=y
CONFIG_ARM_MHU=y
CONFIG_BCM_PDC_MBOX=y
CONFIG_HISI_IOMMU=y
CONFIG_ARM_SMMU=y

CONFIG_CMA=y

##CONFIG_POWER_RESET_SYSCON=y
##CONFIG_SYSCON_REBOOT_MODE=y
CONFIG_POWER_RESET_HI3798CV2X=y

CONFIG_CGROUPS=y
CONFIG_BLK_CGROUP=y
CONFIG_CGROUP_PIDS=y
CONFIG_CGROUP_DEVICE=y
CONFIG_CGROUP_CPUACCT=y
CONFIG_CGROUP_PERF=y

CONFIG_MMC=y
CONFIG_MMC_BLOCK_MINORS=32
CONFIG_MMC_ARMMMCI=y
CONFIG_MMC_DW=y
CONFIG_MMC_DW_K3=y
CONFIG_MMC_DW_HI3798CV200=y

CONFIG_BLK_DEV_SD=y

CONFIG_BLK_CMDLINE_PARSER=y
CONFIG_PARTITION_ADVANCED=y
CONFIG_CMDLINE_PARTITION=y

CONFIG_TMPFS=y
CONFIG_DEVTMPFS=y
CONFIG_DEVTMPFS_MOUNT=y

CONFIG_EXT4_FS=y

CONFIG_NET=y
CONFIG_UNIX=y
CONFIG_INET=y

CONFIG_NETDEVICES=y
CONFIG_MACB=y
CONFIG_HIX5HD2_GMAC=y

CONFIG_HISILICON_VENDOR=y
```

## arch/arm/mach-hi3716mv420n/Kconfig
```kconfig
if ARCH_HI3716MV420N
menu "Hi3716MV420N board feature"

config MACH_HI3716MV420N
	bool "Support Hi3716MV420N platform"
	select CPU_V7
	select ARM_GIC
	select ARM_TIMER_SP804
	select COMMON_CLK
	select ARCH_REQUIRE_GPIOLIB
	select DYNAMIC_DEBUG
	help
	  Include support for the hisilion Hi3716MV420N platform.
	  Hi3716MV420N support ARM CORTEX-A9 processer,
	  within a Generic Interrupt Controller.
	  Support DDR2 and DDR3.

config DEFAULT_UART_BASE_ADDR
	hex "Default uart controller base address"
	default "0xF8B00000"
	help
	  Default UART controller base address

config DEFAULT_VMALLOC_SIZE
	int "Default vmalloc size"
	default 240
	help
	  Default vmalloc size in MBytes. Use "vmalloc=size" to change it.

config MMZ_PARAM
	string "MMZ param for CMA and ION"
	depends on CMA
	default "ddr,0,0,320M" if MACH_HI3716MV420N
	help
	  This is the parameter of mmz memory manager, which now is for CMA 
	  and ION memory manager.

menuconfig SUPPORT_DSP_RUN_MEM
	bool "Support DSP run memory"
	default y
	help
	  Support DSP run memory

config DSP_RUN_MEM_ADDR
	hex "DSP run memory address"
	depends on SUPPORT_DSP_RUN_MEM
	default "0x2000000"
	help
	  The start address of DSP run memory.

config DSP_RUN_MEM_SIZE
	hex "DSP run memory size"
	depends on SUPPORT_DSP_RUN_MEM
	default "0x800000"
	help
	  The size of DSP run memory.

endmenu
endif
```
